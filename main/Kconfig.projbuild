## main/Kconfig.projbuild
```kconfig
menu "YogiGate pins"

    config YG_PIN_REMOTE
        int "Remote MOSFET gate"
        default 10
        help
            Must have no pull-up during reset. On the C6, GPIO18 to GPIO23 do, so
            they could press the remote at every power-on. The gate also needs a
            10 kOhm resistor to GND. With a logic-level MOSFET, a weaker one could
            not hold the gate down against an internal pull-up.

    config YG_PIN_BUZZER
        int "Buzzer, optional"
        default 11

    config YG_PIN_SDA
        int "MPU6050 SDA"
        default 2

    config YG_PIN_SCL
        int "MPU6050 SCL"
        default 3

    config YG_PIN_BUTTON
        int "On-board button"
        default 9
        help
            GPIO9 is the BOOT button on the C6 devkit.

    config YG_PIN_BUTTON_EXT
        int "External button, optional"
        default 7
        help
            Connects to GND, and works the same as the on-board button. Keep it off
            the strapping pins: GPIO9 held low at power-on stops the unit starting.

    config YG_PIN_LED
        int "Addressable RGB LED"
        default 8

    choice YG_GATE_DRIVER
        prompt "Gate driver"
        default YG_GATE_DRIVER_MOSFET
        help
            How the unit opens the gate. MOSFET presses a wired remote's button.
            RF433 transmits a learned fixed code over a CC1101 and has no MOSFET.

        config YG_GATE_DRIVER_MOSFET
            bool "MOSFET on a wired remote"

        config YG_GATE_DRIVER_RF433
            bool "433 MHz CC1101 transceiver"
    endchoice

    config YG_PIN_RF_SCLK
        int "CC1101 SCLK"
        depends on YG_GATE_DRIVER_RF433
        default 6
    config YG_PIN_RF_MISO
        int "CC1101 MISO"
        depends on YG_GATE_DRIVER_RF433
        default 5
    config YG_PIN_RF_MOSI
        int "CC1101 MOSI"
        depends on YG_GATE_DRIVER_RF433
        default 4
    config YG_PIN_RF_CS
        int "CC1101 CSn, driven high at reset so it idles deselected"
        depends on YG_GATE_DRIVER_RF433
        default 10
    config YG_PIN_RF_GDO0
        int "CC1101 GDO0, the async OOK data pin for RMT"
        depends on YG_GATE_DRIVER_RF433
        default 1

endmenu
```
